## buildroot-external/package/toykon-gui/Config.in
```kconfig
config BR2_PACKAGE_TOYKON_GUI
	bool "toykon-gui"
	help
	  The KDE-based visual interface for working with Mycroft.

	  https://github.com/poveteen/toykkon-gui
```
